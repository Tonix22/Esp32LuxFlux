## components/config/Kconfig
```kconfig
menu "LuxFlux board configuration"
    config LUXFLUX_LED_GPIO
        int "Addressable LED data GPIO (-1 disables output)"
        range -1 21
        default -1
        help
            Select a suitable free output pin for your ESP32-C3 board.
            The default disables LED output until board wiring is confirmed.

    config LUXFLUX_I2C_SDA_GPIO
        int "I2C SDA GPIO (-1 unassigned)"
        range -1 21
        default -1
    config LUXFLUX_I2C_SCL_GPIO
        int "I2C SCL GPIO (-1 unassigned)"
        range -1 21
        default -1
    config LUXFLUX_IMU_INT_GPIO
        int "IMU interrupt GPIO (-1 unassigned)"
        range -1 21
        default -1
    config LUXFLUX_MIC_GPIO
        int "Microphone GPIO (-1 unassigned)"
        range -1 21
        default -1
    config LUXFLUX_BATTERY_ADC_GPIO
        int "Battery ADC GPIO (-1 unassigned)"
        range -1 21
        default -1
    config LUXFLUX_STATUS_LED_GPIO
        int "Status LED GPIO (-1 unassigned)"
        range -1 21
        default -1
endmenu
```

## components/drivers/Kconfig
```kconfig
menu "LuxFlux network driver"
    config LUXFLUX_WIFI_DIAGNOSTIC_SCAN
        bool "Scan and log target AP before connecting"
        default n
        help
            For Wi-Fi bring-up only. Logs target AP channel, RSSI and security
            without printing the password. Adds a startup scan delay.
endmenu
```

## components/led_driver/Kconfig
```kconfig
menu "LuxFlux LED driver"
    choice LUXFLUX_LED_PROTOCOL
        prompt "Addressable LED protocol"
        default LUXFLUX_LED_WS2812B
        config LUXFLUX_LED_WS2812B
            bool "WS2812B (800 kHz)"
        config LUXFLUX_LED_SK6812
            bool "SK6812 RGB (800 kHz)"
        config LUXFLUX_LED_WS2811_800
            bool "WS2811 (800 kHz)"
        config LUXFLUX_LED_WS2811_400
            bool "WS2811 (400 kHz)"
        config LUXFLUX_LED_UCS1903
            bool "UCS1903 (400 kHz nominal)"
        config LUXFLUX_LED_SM16703
            bool "SM16703 (800 kHz nominal)"
        config LUXFLUX_LED_GENERIC
            bool "Generic configurable RMT protocol"
    endchoice

    config LUXFLUX_LED_COUNT
        int "LED count"
        range 1 256
        default 16
        help
            Every received RGB frame must describe exactly this many LEDs.
            Match the Python test server's --led-count argument to this value.
    config LUXFLUX_LED_BRIGHTNESS_LIMIT
        int "Maximum channel brightness (0-255 scale)"
        range 1 255
        default 64
    config LUXFLUX_LED_DIAGNOSTIC_ON_BOOT
        bool "Run LED diagnostic sequence on boot"
        default n
        help
            Red, green, blue, then a moving white pixel and off. Requires a
            configured LED GPIO. Verify current and power limits first.

    if LUXFLUX_LED_GENERIC
        config LUXFLUX_LED_GENERIC_T0H_NS
            int "Zero high time (ns)"
            range 100 5000
            default 350
        config LUXFLUX_LED_GENERIC_T0L_NS
            int "Zero low time (ns)"
            range 100 5000
            default 900
        config LUXFLUX_LED_GENERIC_T1H_NS
            int "One high time (ns)"
            range 100 5000
            default 700
        config LUXFLUX_LED_GENERIC_T1L_NS
            int "One low time (ns)"
            range 100 5000
            default 600
        config LUXFLUX_LED_GENERIC_RESET_US
            int "Reset/latch low time (us)"
            range 50 300
            default 80
    endif
endmenu
```

## components/mdns_discovery/Kconfig
```kconfig
menu "LuxFlux mDNS discovery"
    config LUXFLUX_MDNS_QUERY_TIMEOUT_MS
        int "Discovery query timeout (ms)"
        range 200 5000
        default 1200
    config LUXFLUX_MDNS_RETRY_INTERVAL_MS
        int "Delay between discovery attempts (ms)"
        range 100 5000
        default 400
    config LUXFLUX_MDNS_VERIFY_INTERVAL_MS
        int "Assigned-name verification interval (ms)"
        range 5000 300000
        default 30000
endmenu
```

## components/sync_service/Kconfig
```kconfig
menu "LuxFlux RGB synchronization"
    choice LUXFLUX_SYNC_ROLE
        prompt "Synchronization role"
        default LUXFLUX_SYNC_DISABLED
        config LUXFLUX_SYNC_DISABLED
            bool "Disabled"
        config LUXFLUX_SYNC_SERVER
            bool "SoftAP server"
        config LUXFLUX_SYNC_CLIENT
            bool "Station client"
    endchoice
    config LUXFLUX_SYNC_WIFI_SSID
        string "Synchronization Wi-Fi SSID"
        default ""
        help
            Stored only in ignored sdkconfig. Do not commit credentials.
    config LUXFLUX_SYNC_WIFI_PASSWORD
        string "Synchronization Wi-Fi password"
        default ""
    config LUXFLUX_SYNC_SEQUENCE_NAME
        string "Sequence name to request"
        default "default"
    config LUXFLUX_SYNC_SERVER_HOST_OVERRIDE
        string "Optional TCP server address override for lab testing"
        default ""
        help
            Empty uses the Station interface's SoftAP gateway address.
    config LUXFLUX_SYNC_MAX_SEQUENCES
        int "Maximum stored sequences"
        range 1 8
        default 4
    config LUXFLUX_SYNC_MAX_FRAMES
        int "Maximum frames per sequence"
        range 1 256
        default 128
    config LUXFLUX_SYNC_MAX_GROUPS
        int "Maximum groups per frame"
        range 1 256
        default 256
        help
            A group is one count(R,G,B) entry. This limit counts entries,
            not physical LEDs; their counts must total LUXFLUX_LED_COUNT.
    config LUXFLUX_SYNC_MAX_PAYLOAD
        int "Maximum RGB text record bytes"
        range 64 4096
        default 1024
    config LUXFLUX_SYNC_MAX_MEMORY
        int "Maximum stored plus in-flight sequence bytes"
        range 1024 32768
        default 16384
        help
            Caps memory used by stored sequences and a sequence being received.
    config LUXFLUX_SYNC_MIN_DURATION_MS
        int "Minimum frame duration (ms)"
        range 1 1000
        default 1
    config LUXFLUX_SYNC_MAX_DURATION_MS
        int "Maximum frame duration (ms)"
        range 1 60000
        default 10000
    config LUXFLUX_SYNC_SOCKET_TIMEOUT_MS
        int "Socket read/write timeout (ms)"
        range 100 10000
        default 1000
    config LUXFLUX_SYNC_TIMEOUT_RETRIES
        int "Timeout retries per message"
        range 0 5
        default 2
endmenu
```
